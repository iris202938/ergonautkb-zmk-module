## config/west.yml
```yaml
manifest:
  remotes:
    - name: zmkfirmware
      url-base: https://github.com/zmkfirmware
    - name: caksoylar
      url-base: https://github.com/caksoylar
    - name: badjeff
      url-base: https://github.com/badjeff
    - name: zettaface
      url-base: https://github.com/zettaface
    - name: eswai
      url-base: https://github.com/eswai

  projects:
    - name: zmk
      remote: zmkfirmware
      revision: v0.3  # 重複を削除し、一方に固定
      import: app/west.yml
    - name: zmk-rgbled-widget
      remote: caksoylar
      revision: v0.3-branch
    - name: zmk-analog-input-driver
      remote: badjeff
      revision: main
    - name: zmk-input-processor-keybind
      remote: zettaface
      revision: main
    - name: zmk-naginata
      remote: eswai
      revision: main

  self:
    path: config
```
